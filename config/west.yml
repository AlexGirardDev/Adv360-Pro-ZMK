## config/west.yml
```yaml
manifest:
  remotes:
    - name: zmkfirmware
      url-base: https://github.com/zmkfirmware
    - name: refil
      url-base: https://github.com/refil
    - name: urob
      url-base: https://github.com/urob
  projects:
    - name: zmk
      remote: refil
      revision: adv360-z3.5
      import: app/west.yml
    - name: zmk-auto-layer
      revision: main
      remote: urob
      path: modules/auto-layer
    - name: zmk-tri-state
      revision: main
      remote: urob
      path: modules/tri-state
  self:
    path: config
```
